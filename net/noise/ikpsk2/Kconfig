## net/noise/ikpsk2/Kconfig
```kconfig
# SPDX-License-Identifier: GPL-2.0-only
#
# Noise IKpsk2 cryptographic framework configuration
#
config NOISE_IKPSK2
	tristate "Noise IKpsk2 cryptographic framework"
	# NOISE: comment to address
	depends on CRYPTO && KEYS
	# Library interfaces for <crypto/curve25519.h> and
	# <crypto/chacha20poly1305.h>. BLAKE2s is always built-in, so there is
	# no Kconfig symbol to select for <crypto/blake2s.h>.
	select CRYPTO_LIB_CURVE25519
	select CRYPTO_LIB_CHACHA20POLY1305
	default n
	help
	  Kernel-internal Noise IKpsk2 handshake and transport
	  encryption framework using Curve25519, ChaChaPoly, and BLAKE2s.

	  Provides handshake and symmetric encrypt/decrypt
	  symbols for use by other kernel subsystems.

	  If unsure, say N.

# NOISE: comment to address
config NOISE_IKPSK2_SELFTEST
	bool "Noise IKpsk2 crypto selftests (abort module load on failure)"
	depends on NOISE_IKPSK2
	default n
	help
	  Run known-answer / convergence selftests over the Noise IKpsk2
	  crypto core (Diffie-Hellman mixing, KDF, AEAD) when the module is
	  loaded. If any test fails, the module load is aborted.

	  This is a development/verification aid and is compiled into the
	  module only when enabled.

	  If unsure, say N.
```
